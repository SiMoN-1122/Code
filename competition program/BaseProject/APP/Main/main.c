/*********************************************************************************************************
* 模块名称：Main.c
* 摘    要：主文件，包含软硬件初始化函数和main函数
* 当前版本：1.0.0
* 作    者：SZLY(COPYRIGHT 2018 - 2020 SZLY. All rights reserved.)
* 完成日期：2020年01月01日
* 内    容：
* 注    意：                                                             
**********************************************************************************************************
* 取代版本：
* 作    者：
* 完成日期：
* 修改内容：
* 修改文件：
*********************************************************************************************************/

/*********************************************************************************************************
*                                              包含头文件
*********************************************************************************************************/
#include "gr55xx_hal.h"

#include "LED.h"
#include "Timer.h"
#include "UART0.h"
#include "ADC.h"
#include "gr551x_adc_voltage_api.h"
#include "AD8233.h"
#include "JumperData.h"
#include "ECGAlg.h"

#include "gr55xx_sys.h"  //包含一堆头文件，包括下面两个外部变量
#include "user_app.h"    //ble_init_cmp_callback
#include "scatter_common.h"  //STACK_HEAP_INIT(heaps_table);
#include "boards.h"
#include "gus.h"

/*********************************************************************************************************
*                                              宏定义
*********************************************************************************************************/

/*********************************************************************************************************
*                                              内部变量
*********************************************************************************************************/
extern adc_handle_t            g_adc_handle; //adc_handle_t为结构体变量名，g_adc_handle从ADC.c文件中引申

extern gap_cb_fun_t         app_gap_callbacks; //蓝牙功能性结构体变量，包含回调函数，原变量定义在user_gap_callback.c中
extern gatt_common_cb_fun_t app_gatt_common_callback;

STACK_HEAP_INIT(heaps_table);

//该结构体的各个回调函数会在库里面被调用（应该）
static app_callback_t s_app_ble_callback =
{
    .app_ble_init_cmp_callback = ble_init_cmp_callback,     //初始化完成回调函数，初始化指设备各个外设有关的初始化，还未连接（cmp是complete的缩写，，，）。Init函数的集合，调用部分库函数初始化服务、gap然后开始蓝牙广播
    .app_gap_callbacks         = &app_gap_callbacks,        //没啥意义，连接、广播等过程都在库实现，这里的回调相当于完成后跟你说一声
                                                            //文件中进行const定义，大概是五六十行，不同工程作为参数的回调函数数量、名称不同
    .app_gatt_common_callback  = &app_gatt_common_callback, //这里更是，完全为空都可以
    .app_gattc_callback        = NULL,
    .app_sec_callback          = NULL,
};


static u16 s_arrWaveData[25] = {0};
static int s_iDataNum = 0;
/*********************************************************************************************************
*                                              枚举结构体定义
*********************************************************************************************************/

/*********************************************************************************************************
*                                              内部函数声明
*********************************************************************************************************/
static  void  InitHardware(void);   //初始化硬件相关的模块
static  void  InitSoftware(void);   //初始化软件相关的模块
static  void  Proc2msTask(void);    //2ms处理任务
static  void  Proc1SecTask(void);   //1s处理任务

/*********************************************************************************************************
*                                              内部函数实现
*********************************************************************************************************/
/*********************************************************************************************************
* 函数名称：InitHardware
* 函数功能：所有的硬件相关的模块初始化函数都放在此函数中
* 输入参数：void
* 输出参数：void
* 返 回 值：void
* 创建日期：2018年01月01日
* 注    意：
*********************************************************************************************************/
static  void  InitHardware(void)
{  
//  hal_init();
  
  InitLED();          //初始化LED模块
  InitTimer();
  InitUART0(115200);  //初始化UART模块
  InitAD8233();  //全集成式单导联ECG前端，运算放大器（仪表放大器、增益放大器、基准电压缓冲等）处理电极到处理器过程中的信号
  
  
}

/*********************************************************************************************************
* 函数名称：InitSoftware
* 函数功能：所有的软件相关的模块初始化函数都放在此函数中
* 输入参数：void
* 输出参数：void
* 返 回 值：void
* 创建日期：2018年01月01日
* 注    意：
*********************************************************************************************************/
static  void  InitSoftware(void)
{
  ECG_Init();//心电算法
  InitJumperData();//数据包模块
  ble_stack_init(&s_app_ble_callback, &heaps_table);//在ble.h中，初始化蓝牙堆栈
}

/*********************************************************************************************************
* 函数名称：Proc2msTask
* 函数功能：2ms处理任务 
* 输入参数：void
* 输出参数：void
* 返 回 值：void
* 创建日期：2018年01月01日
* 注    意：
*********************************************************************************************************/
static  void  Proc2msTask(void)
{
  static int s_iCnt2  = 0;  //每4ms添加一个数据，添加25个数据后自动发送
  static u16 V_num;
  static double V = 0;
  
  
  if(ReadADCBuf(&V_num))
  {
    V_num = ECG_Test(V_num,NULL);//对采集到的数据先处理一遍
    hal_gr551x_adc_voltage_intern(&g_adc_handle, &V_num, &V, 1);//好像是对V_num的数据进行某种模式的处理之后赋值给V
    //printf("%f\r\n",V);
  } 
  
  if(Get2msFlag())  //判断2ms标志状态
  {
    LEDFlicker(250);//调用闪烁函数     

    if(s_iCnt2 >= 1)
    { 
      
      LeadDetect();   //进行导联检测
     
      if(leadResult)//全局变量，导联标志位
      {
        g_structECGPara.status      |= 0x80;//也是个全局结构体（心电参数）
        DataAccess(V);//好像是通过当前测得的最大和最小心电位，不断拓宽上下限，来预测下一次波形的范围，同时把处理好的数据直接添加进波形数据包中，波形数据包攒够数据会自动通过蓝牙发送
      }
      else
      {
        LEDFlicker(100);//调用闪烁函数
        g_structECGPara.HeartRateH   = 0;    //暂时不知道为什么，不导联时心率也不为0，并且变得很忙，是手机太卡了吗
        g_structECGPara.HeartRateL   = 0;
        g_structECGPara.status      &= 0;
      }
      
      
      s_iCnt2 = 0;
    }
    else
    {
      s_iCnt2++;
    }
           
    Clr2msFlag();   //清除2ms标志
  }
}

/*********************************************************************************************************
* 函数名称：Proc1SecTask
* 函数功能：1s处理任务 
* 输入参数：void
* 输出参数：void
* 返 回 值：void
* 创建日期：2018年01月01日
* 注    意：
*********************************************************************************************************/
static  void  Proc1SecTask(void)
{   
  static u16 V_num;
  static double BattADC;
  
  if(Get1SecFlag()) //判断1s标志状态
  {
    //获取电池电量
    SetADCChannel(BATT_CHANNEL);//借你ADC用一下
    
    while(ReadADCBuf(&V_num) == 0)//ADC缓冲区的数据如何区分？？？。。懂了，双ADC通道，一个接心电数据，一个接电量数据
		{
			hal_gr551x_adc_voltage_intern(&g_adc_handle, &V_num, &BattADC, 1);//对V_num处理之后传给BattADC
		}
    
    g_structECGPara.batteryCapacity = (u8)(100/BatteryDiff * (BattADC - BatteryMin));//算出电池电量百分比之后传递给结构体电量参数
   
    
    SetADCChannel(ECG_CHANNEL);//马上还
  
    ECGParaSend();//发送心电参数数据包，上面那个是波形数据包
    //printf("This is the first ？？？ Project, by Zhangsan\r\n");
    
    
    Clr1SecFlag();  //清除1s标志
  }    
}
/*********************************************************************************************************
* 函数名称：main
* 函数功能：主函数 
* 输入参数：void
* 输出参数：void
* 返 回 值：int
* 创建日期：2018年01月01日
* 注    意：
*********************************************************************************************************/
int main(void)
{ 
  InitHardware();   //初始化硬件相关函数
  InitSoftware();   //初始化软件相关函数
  
  printf("Init System has been finished.\r\n" );  //打印系统状态

  while(1)
  {
    Proc2msTask();  //2ms处理任务
    Proc1SecTask(); //1s处理任务   
  }
}
