/*********************************************************************************************************
* 模块名称：LED.c
* 摘    要：LED模块
* 当前版本：1.0.0
* 作    者：SZLY(COPYRIGHT 2018 - 2020 SZLY. All rights reserved.)
* 完成日期：2020年01月01日 
* 内    容：
* 注    意：                                                                  
**********************************************************************************************************
* 取代版本：
* 作    者：
* 完成日期：
* 修改内容：
* 修改文件：
*********************************************************************************************************/

/*********************************************************************************************************
*                                              包含头文件
*********************************************************************************************************/
#include "LED.h"
#include "gr55xx_hal.h"

/*********************************************************************************************************
*                                              宏定义
*********************************************************************************************************/

/*********************************************************************************************************
*                                              枚举结构体定义
*********************************************************************************************************/

/*********************************************************************************************************
*                                              内部变量
*********************************************************************************************************/

/*********************************************************************************************************
*                                              内部函数声明
*********************************************************************************************************/
static  void  ConfigLEDGPIO(void);  //配置LED的GPIO

/*********************************************************************************************************
*                                              内部函数实现
*********************************************************************************************************/
/*********************************************************************************************************
* 函数名称：ConfigLEDGPIO
* 函数功能：配置LED的GPIO 
* 输入参数：void 
* 输出参数：void
* 返 回 值：void
* 创建日期：2018年01月01日
* 注    意：
*********************************************************************************************************/
static  void  ConfigLEDGPIO(void)
{
  gpio_init_t gpio_config = GPIO_DEFAULT_CONFIG;

  gpio_config.mode = GPIO_MODE_OUTPUT;
  gpio_config.pin  = RED_PIN | GREEN_PIN | BLUE_PIN;
  hal_gpio_init(GPIO0, &gpio_config);
  
  hal_gpio_write_pin(GPIO0, BLUE_PIN |GREEN_PIN | RED_PIN, GPIO_PIN_RESET);          //将LED默认状态设置为熄灭

}

/*********************************************************************************************************
*                                              API函数实现
*********************************************************************************************************/
/*********************************************************************************************************
* 函数名称：InitLED
* 函数功能：初始化LED模块
* 输入参数：void
* 输出参数：void
* 返 回 值：void
* 创建日期：2018年01月01日
* 注    意：
*********************************************************************************************************/
void InitLED(void)
{
  ConfigLEDGPIO();  //配置LED的GPIO
}

/*********************************************************************************************************
* 函数名称：LEDFlicker
* 函数功能：LED闪烁函数
* 输入参数：cnt
* 输出参数：void
* 返 回 值：void
* 创建日期：2018年01月01日
* 注    意：LEDFlicker在Proc2msTask中调用，cnt为250时表示每500ms更改一次LED状态
*********************************************************************************************************/
void LEDFlicker(u16 cnt)
{
  static u16 s_iCnt;  //定义静态变量s_iCnt作为计数器
  
  s_iCnt++; //计数器的计数值加1
  
  if(s_iCnt >= cnt)   //计数器的计数值大于cnt
  { 
    s_iCnt = 0;       //重置计数器的计数值为0
    
    //LED状态取反，实现LED闪烁
    hal_gpio_toggle_pin(GPIO0, LED_PIN);
  }
}

/*********************************************************************************************************
* 函数名称：ColorCycle_3
* 函数功能：三色循环函数
* 输入参数：cnt
* 输出参数：void
* 返 回 值：void
* 创建日期：2018年01月01日
* 注    意：LEDFlicker在Proc2msTask中调用，cnt为250时表示每500ms更改一次LED状态
*********************************************************************************************************/
void ColorCycle_3(u16 cnt)
{
  static u16 s_iCnt = 0;  //定义静态变量s_iCnt作为计数器
  
  s_iCnt++; //计数器的计数值加1
  
  if(s_iCnt == cnt )   
  { 
    hal_gpio_write_pin(GPIO0, RED_PIN | BLUE_PIN, GPIO_PIN_RESET);          //将LED默认状态设置为熄灭
    hal_gpio_write_pin(GPIO0, GREEN_PIN, GPIO_PIN_SET);
  }
   else if(s_iCnt == 2 * cnt)   
  { 
    hal_gpio_write_pin(GPIO0, GREEN_PIN | RED_PIN, GPIO_PIN_RESET);          //将LED默认状态设置为熄灭
    hal_gpio_write_pin(GPIO0, BLUE_PIN, GPIO_PIN_SET);
  }
   else if(s_iCnt == 3 * cnt)   
  { 
    s_iCnt = 0;     
    
    hal_gpio_write_pin(GPIO0, GREEN_PIN | BLUE_PIN, GPIO_PIN_RESET);          //将LED默认状态设置为熄灭
    hal_gpio_write_pin(GPIO0, RED_PIN, GPIO_PIN_SET);
  }
}
