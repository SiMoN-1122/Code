/*********************************************************************************************************
* 模块名称：ADC.c
* 摘    要：ADC模块
* 当前版本：1.0.0
* 作    者：SZLY(COPYRIGHT 2018 - 2020 SZLY. All rights reserved.)
* 完成日期：2020年01月01日
* 内    容：
* 注    意：                                                                  
**********************************************************************************************************
* 取代版本：
* 作    者：
* 完成日期：
* 修改内容：
* 修改文件：
*********************************************************************************************************/
/*********************************************************************************************************
*                                              包含头文件
*********************************************************************************************************/
#include "ADC.h"
#include "gr55xx_hal.h"
#include "gr551x_adc_voltage_api.h"
#include "U16Queue.h"
#include "GR5515_SK.h"
#include "AD8233.h"

/*********************************************************************************************************
*                                              宏定义
*********************************************************************************************************/

/*********************************************************************************************************
*                                              枚举结构体定义
*********************************************************************************************************/

/*********************************************************************************************************
*                                              内部变量
*********************************************************************************************************/
static u16 s_arrADCData[8];   //可以取平均
static StructU16CirQue  s_structADCCirQue;            //ADC循环队列
static u16              s_arrADCBuf[ADC_BUF_SIZE];   //ADC循环队列的缓冲区
adc_handle_t            g_adc_handle;
static dma_handle_t s_dma_handle;

/*********************************************************************************************************
*                                              内部函数声明
*********************************************************************************************************/
static void ConfigADC(int ch);     //配置ADC

/*********************************************************************************************************
*                                              内部函数实现
*********************************************************************************************************/
/*********************************************************************************************************
* 函数名称：ConfigADC1
* 函数功能：配置ADC1
* 输入参数：void
* 输出参数：void
* 返 回 值：void
* 创建日期：2018年01月01日
* 注    意：ADC123_IN1-PA1
**********************************************************************************************************/
static void ConfigADC(int ch)
{  
  if(ch == ECG_CHANNEL)//看看心电
  {
    g_adc_handle.init.channel_n  = ADC_INPUT_SRC_IO0;
  }
  else if(ch == BATT_CHANNEL)//看看电池
  {
    g_adc_handle.init.channel_n  = ADC_INPUT_SRC_IO1;
    
  }
  
  
//  g_adc_handle.init.channel_p  = ADC_INPUT_SRC_IO0;
  g_adc_handle.init.input_mode = ADC_INPUT_SINGLE;    //单端模式：只采样N通道
  g_adc_handle.init.ref_source = ADC_REF_SRC_BUF_INT;
  g_adc_handle.init.ref_value  = ADC_REF_VALUE_0P8;
  g_adc_handle.init.clock      = ADC_CLK_1M;
  
  hal_adc_deinit(&g_adc_handle);
  hal_adc_init(&g_adc_handle);

}

/*********************************************************************************************************
* 函数名称：ConfigDMA1Ch1
* 函数功能：配置DMA通道1
* 输入参数：void
* 输出参数：void
* 返 回 值：void
* 创建日期：2018年01月01日
* 注    意：
**********************************************************************************************************/
void hal_adc_msp_init(adc_handle_t *p_adc)
{
    msio_init_t msio_config = MSIO_DEFAULT_CONFIG;

    NVIC_ClearPendingIRQ(DMA_IRQn);
    hal_nvic_enable_irq(DMA_IRQn);

    /* Config input GPIO */
    msio_config.pin  = ADC_P_INPUT_PIN | ADC_N_INPUT_PIN;
    msio_config.mode = MSIO_MODE_ANALOG;
    hal_msio_init(&msio_config);

    /* Configure the DMA handler for Transmission process */
    p_adc->p_dma = &s_dma_handle;
    s_dma_handle.p_parent = p_adc;
    p_adc->p_dma->channel           = DMA_Channel0;
    p_adc->p_dma->init.src_request   = DMA_REQUEST_SNSADC;
    p_adc->p_dma->init.direction     = DMA_PERIPH_TO_MEMORY;
    p_adc->p_dma->init.src_increment = DMA_SRC_NO_CHANGE;
    p_adc->p_dma->init.dst_increment = DMA_DST_INCREMENT;
    p_adc->p_dma->init.src_data_alignment = DMA_SDATAALIGN_WORD;
    p_adc->p_dma->init.dst_data_alignment = DMA_DDATAALIGN_WORD;
    p_adc->p_dma->init.mode          = DMA_NORMAL;
    p_adc->p_dma->init.priority      = DMA_PRIORITY_LOW;

    hal_dma_init(p_adc->p_dma);
}

void hal_adc_msp_deinit(adc_handle_t *p_adc)
{
    hal_msio_deinit(ADC_P_INPUT_PIN | ADC_N_INPUT_PIN);
    hal_dma_deinit(p_adc->p_dma);
}
/*********************************************************************************************************
* 函数名称：hal_adc_conv_cplt_callback
* 函数功能：中断回调函数
* 输入参数：void
* 输出参数：void
* 返 回 值：void
* 创建日期：2018年01月01日
* 注    意：
**********************************************************************************************************/
void hal_adc_conv_cplt_callback(adc_handle_t *p_adc)
{
//  WriteADCBuf(s_arrADCData);
}

/*********************************************************************************************************
*                                              API函数实现
*********************************************************************************************************/
/*********************************************************************************************************
* 函数名称：InitADC
* 函数功能：初始化ADC模块
* 输入参数：void
* 输出参数：void
* 返 回 值：void
* 创建日期：2018年01月01日
* 注    意：
**********************************************************************************************************/
void InitADC(int ch)
{
  ConfigADC(ch);             //配置ADC
  InitU16Queue(&s_structADCCirQue, s_arrADCBuf, ADC_BUF_SIZE); //初始化ADC缓冲区  
}

/*********************************************************************************************************
* 函数名称：WriteADCBuf
* 函数功能：获取num个数据
* 输入参数：d-待写入的数据
* 输出参数：void
* 返 回 值：成功标志位，1为成功，0为不成功
* 创建日期：2018年01月01日
* 注    意：
**********************************************************************************************************/
void ADCDataGet(int num)
{  
  hal_adc_start_dma(&g_adc_handle, s_arrADCData, num);
  while (g_adc_handle.state == HAL_ADC_STATE_BUSY);       //常常会卡在这里，需要注意一下（好像不连蓝牙就没事？）
    
  EnU16Queue(&s_structADCCirQue, s_arrADCData, 1);
}

/*********************************************************************************************************
* 函数名称：ReadADCBuf
* 函数功能：从ADC缓冲区读取数据
* 输入参数：p-读取的数据存放的首地址
* 输出参数：void
* 返 回 值：成功标志位，1为成功，0为不成功
* 创建日期：2018年01月01日
* 注    意：
**********************************************************************************************************/
u8 ReadADCBuf(u16* p)
{
  u8 ok = 0;  //将读取成功标志位的值设置为0

  ok = DeU16Queue(&s_structADCCirQue, p, 1); //出队

  return ok;  //返回读取成功标志位的值
}

/*********************************************************************************************************
* 函数名称：SetADCChannel
* 函数功能：设置当前ADC通道
* 输入参数：void
* 输出参数：void
* 返 回 值：void
* 创建日期：2018年01月01日
* 注    意：
*********************************************************************************************************/
void SetADCChannel(int ch)
{
  InitADC(ch);
}

