 /*********************************************************************************************************
* 模块名称：Timer.c
* 摘    要：Timer模块
* 当前版本：1.0.0
* 作    者：SZLY(COPYRIGHT 2018 - 2020 SZLY. All rights reserved.)
* 完成日期：2020年01月01日  
* 内    容：
* 注    意：                                                                  
**********************************************************************************************************
* 取代版本：
* 作    者：
* 完成日期：
* 修改内容：
* 修改文件：
*********************************************************************************************************/

/*********************************************************************************************************
*                                              包含头文件
*********************************************************************************************************/
#include "Timer.h"
#include "gr55xx_hal.h"
#include "ADC.h"

/*********************************************************************************************************
*                                              宏定义
*********************************************************************************************************/
timer_handle_t g_tim0_handle;
timer_handle_t g_tim1_handle;
/*********************************************************************************************************
*                                              枚举结构体定义
*********************************************************************************************************/

/*********************************************************************************************************
*                                              内部变量
*********************************************************************************************************/
static  u8  s_i2msFlag  = FALSE;    //将2ms标志位的值设置为FALSE
static  u8  s_i1secFlag = FALSE;    //将1s标志位的值设置为FALSE

/*********************************************************************************************************
*                                              内部函数声明
*********************************************************************************************************/
static  void  ConfigTimer0(u16 arr);  //配置TIM0
static  void  ConfigTimer1(u16 arr);  //配置TIM1

/*********************************************************************************************************
*                                              内部函数实现
*********************************************************************************************************/
/*********************************************************************************************************
* 函数名称：ConfigTimer0
* 函数功能：配置TIM0
* 输入参数：arr-自动重装值
* 输出参数：void
* 返 回 值：void
* 创建日期：2018年01月01日
* 注    意：
*********************************************************************************************************/
static  void ConfigTimer0(u16 arr)
{
  g_tim0_handle.p_instance = TIMER0;
  g_tim0_handle.init.auto_reload = SystemCoreClock/arr - 1;
  hal_timer_base_init(&g_tim0_handle);

  hal_timer_base_start_it(&g_tim0_handle);
  
}


/*********************************************************************************************************
* 函数名称：ConfigTimer1
* 函数功能：配置TIM1
* 输入参数：arr-自动重装值
* 输出参数：void
* 返 回 值：void
* 创建日期：2018年01月01日
* 注    意：
*********************************************************************************************************/
static  void ConfigTimer1(u16 arr)
{
  g_tim1_handle.p_instance = TIMER1;
  g_tim1_handle.init.auto_reload = SystemCoreClock/arr - 1;
  hal_timer_base_init(&g_tim1_handle);

  hal_timer_base_start_it(&g_tim1_handle);
  
}

/*********************************************************************************************************
* 函数名称：hal_timer_period_elapsed_callback
* 函数功能：定时器中断服务函数 
* 输入参数：void
* 输出参数：void
* 返 回 值：void
* 创建日期：2018年01月01日
* 注    意：每毫秒进入一次中断服务函数
*********************************************************************************************************/
void hal_timer_period_elapsed_callback(timer_handle_t *p_timer)
{
  static  i16 s_iCnt2  = 0;
  static  i16 s_iCnt1000  = 0;
  
  static  i16 s_iTim1Cnt100  = 0;
  
  
  if (p_timer->p_instance == TIMER0)
  {
    s_iCnt2++;
    s_iCnt1000++;
    
    if(s_iCnt2 >= 2)  //2ms计数器的计数值大于或等于2
    { 
                 
      s_iCnt2 = 0;          //重置2ms计数器的计数值为0
      s_i2msFlag = TRUE;    //将2ms标志位的值设置为TRUE
      
    }
    
    if(s_iCnt1000 >= 1000)  //1s计数器的计数值大于或等于1000
    { 
                 
      s_iCnt1000 = 0;          //重置1s计数器的计数值为0
      s_i1secFlag = TRUE;      //将1s标志位的值设置为TRUE
    }
        
  }
  
  if (p_timer->p_instance == TIMER1)
  {
    s_iTim1Cnt100++;
    
    if(s_iTim1Cnt100 >= 4) 
    { 
                 
      s_iTim1Cnt100 = 0;        
      
      ADCDataGet(8);
    }
  }
}

/*********************************************************************************************************
*                                              API函数实现
*********************************************************************************************************/
/*********************************************************************************************************
* 函数名称：InitTimer
* 函数功能：初始化Timer模块 
* 输入参数：void
* 输出参数：void
* 返 回 值：void
* 创建日期：2018年01月01日
* 注    意：使用的TIM2-7由APB1(36MHz)预分频后输出。如果预分频为1，则由APB1*1输出，否则由APB1*2(72MHz)输出
*********************************************************************************************************/
void InitTimer(void)
{
  ConfigTimer0(1000);  //设置1ms触发一次中断，若参数为1则为1s
  ConfigTimer1(1000);  //设置1ms触发一次中断，转换一次ADC值
}

/*********************************************************************************************************
* 函数名称：Get2msFlag
* 函数功能：获取2ms标志位的值  
* 输入参数：void
* 输出参数：void
* 返 回 值：s_i2msFlag-2ms标志位的值
* 创建日期：2018年01月01日
* 注    意：
*********************************************************************************************************/
u8  Get2msFlag(void)
{
  return(s_i2msFlag);     //返回2ms标志位的值
}

/*********************************************************************************************************
* 函数名称：Clr2msFlag
* 函数功能：清除2ms标志位  
* 输入参数：void
* 输出参数：void
* 返 回 值：void
* 创建日期：2018年01月01日
* 注    意：
*********************************************************************************************************/
void  Clr2msFlag(void)
{
  s_i2msFlag = FALSE;     //将2ms标志位的值设置为FALSE 
}

/*********************************************************************************************************
* 函数名称：Get1SecFlag
* 函数功能：获取1s标志位的值  
* 输入参数：void
* 输出参数：void
* 返 回 值：s_i1secFlag-1s标志位的值
* 创建日期：2018年01月01日
* 注    意：
*********************************************************************************************************/
u8  Get1SecFlag(void)
{
  return(s_i1secFlag);    //返回1s标志位的值
}

/*********************************************************************************************************
* 函数名称：Clr1SecFlag
* 函数功能：清除1s标志位  
* 输入参数：void
* 输出参数：void
* 返 回 值：void
* 创建日期：2018年01月01日
* 注    意：
*********************************************************************************************************/
void  Clr1SecFlag(void)
{
  s_i1secFlag = FALSE;    //将1s标志位的值设置为FALSE
}
